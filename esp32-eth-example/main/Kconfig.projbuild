## esp32-robot-controller/main/Kconfig.projbuild
```kconfig
# ============================================================================
# ESP32-S3 Robot Controller — Kconfig.projbuild
#
# Single source of truth for ALL module configuration.
# Access via: idf.py menuconfig
#
# Menus:
#   1. WiFi Configuration        — from esp32-eth-example (network.c)
#   2. Ethernet Configuration    — from esp32-eth-example (network.c)
#   3. Robot Controller Configuration — motors, sensors, TCP, camera
#
# Author: Ahmed Al-Alousi
# Date: February 2026
# ============================================================================

# ============================================================================
# Network Configuration (from esp32-community-projects dual-interface)
# These menus are required by network.c
# ============================================================================

menu "WiFi Configuration"

    config WIFI_SSID
        string "WiFi SSID"
        default "myssid"
        help
            SSID (network name) to connect to.

    config WIFI_PASSWORD
        string "WiFi Password"
        default "mypassword"
        help
            WiFi password (WPA2).

endmenu

menu "Ethernet Configuration"
    config ENABLE_ETHERNET
        bool "Enable Ethernet (W5500)"
        default y
        select ETH_ENABLED
        select ETH_USE_SPI_ETHERNET
        select ETH_SPI_ETHERNET_W5500
        help
            Enable W5500 Ethernet module for wired network connectivity.
            The Waveshare ESP32-S3-ETH has an integrated W5500.

    if ENABLE_ETHERNET
        config ETH_SPI_HOST
            int "SPI Host"
            default 2
            range 0 2
            help
                SPI peripheral to use for W5500 communication.
                SPI2_HOST = 2 (recommended for ESP32-S3).

        config ETH_SPI_SCLK_GPIO
            int "SPI SCLK GPIO"
            range 0 48
            default 13
            help
                GPIO pin for SPI clock line (SCK).
                Waveshare ESP32-S3-ETH default: 13.

        config ETH_SPI_MOSI_GPIO
            int "SPI MOSI GPIO"
            range 0 48
            default 11
            help
                GPIO pin for SPI Master Out Slave In (MOSI).
                Waveshare ESP32-S3-ETH default: 11.

        config ETH_SPI_MISO_GPIO
            int "SPI MISO GPIO"
            range 0 48
            default 12
            help
                GPIO pin for SPI Master In Slave Out (MISO).
                Waveshare ESP32-S3-ETH default: 12.

        config ETH_SPI_CS_GPIO
            int "SPI CS GPIO"
            range 0 48
            default 14
            help
                GPIO pin for SPI Chip Select (CS).
                Waveshare ESP32-S3-ETH default: 14.

        config ETH_SPI_INT_GPIO
            int "Interrupt GPIO"
            range -1 48
            default 10
            help
                GPIO pin for W5500 interrupt (optional, -1 to disable).
                Waveshare ESP32-S3-ETH default: 10.

        config ETH_SPI_CLOCK_MHZ
            int "SPI Clock Speed (MHz)"
            default 20
            range 1 40
            help
                SPI clock frequency for W5500 communication.
                20MHz is recommended for stable operation.

        config ETH_PHY_RST_GPIO
            int "PHY Reset GPIO"
            range -1 48
            default 9
            help
                GPIO pin for W5500 reset (optional, -1 to disable).
                Waveshare ESP32-S3-ETH default: 9.

        config ETH_PHY_ADDR
            int "PHY Address"
            default 1
            range 0 31
            help
                W5500 PHY address (usually 1).
    endif
endmenu

# ============================================================================
# Robot Controller Configuration
# ============================================================================

menu "Robot Controller Configuration"

    # ========================================================================
    # Motor Driver Configuration
    # ========================================================================
    menu "Motor Driver Configuration"

        choice MOTOR_DRIVE_MODE
            prompt "Drive mode"
            default MOTOR_DRIVE_MODE_FOUR_WHEEL
            help
                Select how motors are driven.

            config MOTOR_DRIVE_MODE_TWO_WHEEL
                bool "Two-wheel (rear only)"
                help
                    Only rear motors are driven. Front wheels free-roll.

            config MOTOR_DRIVE_MODE_FOUR_WHEEL
                bool "Four-wheel (all driven)"
                help
                    All four motors driven independently.

            config MOTOR_DRIVE_MODE_TRACKED
                bool "Tracked / tank drive"
                help
                    Left and right motor pairs locked together.
        endchoice

        config MOTOR_WHEEL_BASE_MM
            int "Wheel base width (mm)"
            default 200
            range 50 1000
            help
                Distance between left and right wheel centres in millimetres.
                Used for skid-steer kinematic calculations.

        config MOTOR_MAX_SPEED_MMS
            int "Maximum speed (mm/s)"
            default 500
            range 100 5000
            help
                Maximum linear speed at 100% PWM duty, in mm/s.
                Used to convert velocity commands to PWM percentages.

        config MOTOR_MAX_DUTY_PCT
            int "Maximum PWM duty (%)"
            default 80
            range 10 100
            help
                Limit maximum PWM duty cycle. Set below 100% to protect
                motors during development or limit top speed.

        config MOTOR_PWM_FREQ_HZ
            int "PWM frequency (Hz)"
            default 5000
            range 1000 50000
            help
                Motor PWM frequency. 5 kHz is typical for DC motors.
                Higher frequencies reduce audible whine but increase
                switching losses.

        menu "Motor GPIO Pins"
            comment "Must not conflict with SPI (9-14), USB (19-20), UART (43-44)"

            config MOTOR_FL_PWM_GPIO
                int "Front-left PWM GPIO"
                default 4
                range 0 48

            config MOTOR_FL_DIR_GPIO
                int "Front-left direction GPIO"
                default 5
                range 0 48

            config MOTOR_FR_PWM_GPIO
                int "Front-right PWM GPIO"
                default 6
                range 0 48

            config MOTOR_FR_DIR_GPIO
                int "Front-right direction GPIO"
                default 7
                range 0 48

            config MOTOR_RL_PWM_GPIO
                int "Rear-left PWM GPIO"
                default 15
                range 0 48

            config MOTOR_RL_DIR_GPIO
                int "Rear-left direction GPIO"
                default 16
                range 0 48

            config MOTOR_RR_PWM_GPIO
                int "Rear-right PWM GPIO"
                default 17
                range 0 48

            config MOTOR_RR_DIR_GPIO
                int "Rear-right direction GPIO"
                default 18
                range 0 48

        endmenu  # Motor GPIO Pins

    endmenu  # Motor Driver Configuration

    # ========================================================================
    # PID Heading Correction
    # ========================================================================
    menu "PID Heading Correction"

        config PID_ENABLED
            bool "Enable PID heading correction"
            default y
            help
                Use IMU yaw rate feedback to correct heading drift
                during straight-line driving. Requires a connected IMU.

        config PID_KP
            int "Proportional gain (x100)"
            default 150
            range 0 10000
            depends on PID_ENABLED
            help
                Proportional gain multiplied by 100.
                Value 150 = Kp of 1.50.

        config PID_KI
            int "Integral gain (x100)"
            default 20
            range 0 10000
            depends on PID_ENABLED
            help
                Integral gain multiplied by 100. Value 20 = Ki of 0.20.

        config PID_KD
            int "Derivative gain (x100)"
            default 5
            range 0 10000
            depends on PID_ENABLED
            help
                Derivative gain multiplied by 100. Value 5 = Kd of 0.05.

        config PID_INTEGRAL_LIMIT
            int "Integral windup limit"
            default 50
            range 1 1000
            depends on PID_ENABLED
            help
                Maximum absolute value of the integral accumulator.
                Prevents integral windup when the robot is stuck.

        config PID_OUTPUT_LIMIT
            int "Output limit"
            default 30
            range 1 100
            depends on PID_ENABLED
            help
                Maximum absolute PID correction applied to left/right
                motor speed difference. Limits how aggressively the
                PID can steer.

    endmenu  # PID Heading Correction

    # ========================================================================
    # I2C Bus Configuration (shared by IMU and URM09)
    # ========================================================================
    menu "I2C Bus Configuration"
        comment "Shared I2C bus for IMU and ultrasonic sensor"

        config SENSOR_I2C_SDA
            int "I2C SDA GPIO"
            default 38
            range 0 48
            help
                GPIO pin for I2C data line. Must not conflict with
                motor, SPI (W5500), or camera pins.

        config SENSOR_I2C_SCL
            int "I2C SCL GPIO"
            default 39
            range 0 48
            help
                GPIO pin for I2C clock line.

        config IMU_I2C_ADDR
            hex "MPU-9250 I2C address"
            default 0x68
            help
                7-bit I2C address of the MPU-9250 IMU.
                0x68 when AD0 is low, 0x69 when AD0 is high.

        config URM09_I2C_ADDR
            hex "URM09 I2C address"
            default 0x11
            help
                7-bit I2C address of the DFRobot URM09 ultrasonic sensor.
                Default is 0x11. Can be changed via the sensor's
                configuration register.

    endmenu  # I2C Bus Configuration

    # ========================================================================
    # Sensor Task Configuration
    # ========================================================================
    menu "Sensor Task Configuration"

        config SENSOR_TASK_STACK_SIZE
            int "Sensor task stack size (bytes)"
            default 4096
            range 2048 16384
            help
                FreeRTOS stack allocation for the sensor polling task.

        config SENSOR_TASK_PRIORITY
            int "Sensor task priority"
            default 6
            range 1 25
            help
                FreeRTOS task priority for the sensor polling task.
                Should be higher than the TCP tasks (5) to ensure
                timely IMU reads for PID correction, but lower than
                the motor control priority.

	config SENSOR_POLL_INTERVAL_MS
            int "Sensor poll interval (ms)"
            default 100
            range 10 1000
            help
                How often to read sensors. 100ms = 10 Hz.
                Must be >= 40ms for URM09 at 500cm range.

    endmenu  # Sensor Task Configuration

    # ========================================================================
    # TCP Communication
    # ========================================================================
    menu "TCP Communication"

        config TCP_CMD_PORT
            int "Motor command server port"
            default 8080
            range 1024 65535
            help
                TCP port on which the ESP32 listens for motor commands
                from the ROS2 waveshare_driver node on the Pi.
                Protocol: JSON lines, e.g. {"linear":0.5,"angular":0.1}

        config TCP_SENSOR_PORT
            int "Sensor data client port"
            default 8081
            range 1024 65535
            help
                TCP port on the Pi to which the ESP32 sends sensor data.
                Protocol: JSON lines, e.g. {"type":"range","distance":0.35}

        config TCP_SENSOR_HOST
            string "Pi IP address (sensor data destination)"
            default "192.168.1.100"
            help
                IP address of the Raspberry Pi running the ROS2
                waveshare_driver node. The ESP32 connects to this
                address on the sensor port to send IMU and range data.

        config TCP_CAMERA_PORT
            int "Camera MJPEG stream port"
            default 8082
            range 1024 65535
            help
                HTTP port for the MJPEG camera stream served by the ESP32.
                The Pi fetches frames from http://<esp32_ip>:<port>/stream

    endmenu  # TCP Communication

    # ========================================================================
    # Camera Configuration (optional — disabled by default)
    # ========================================================================
    menu "Camera Configuration"

        config CAMERA_ENABLED
            bool "Enable camera support"
            default n
            help
                Enable OV2640/OV5640 camera module for MJPEG streaming.
                Disable to save resources if no camera is connected.

        menu "Camera Image Settings"
            depends on CAMERA_ENABLED

            choice CAM_FRAME_SIZE
                prompt "Frame size (resolution)"
                default CAM_FRAME_SIZE_QVGA
                help
                    Camera resolution. Larger sizes produce better images
                    but increase heat, memory usage, and network bandwidth.
                    
                    For thermal management, QVGA (320x240) is recommended.
                    VGA (640x480) will cause significant heat buildup.

                config CAM_FRAME_SIZE_QQVGA
                    bool "QQVGA (160x120) — minimal heat, very low quality"

                config CAM_FRAME_SIZE_QVGA
                    bool "QVGA (320x240) — low heat, acceptable quality [RECOMMENDED]"

                config CAM_FRAME_SIZE_CIF
                    bool "CIF (400x296) — moderate heat"

                config CAM_FRAME_SIZE_HVGA
                    bool "HVGA (480x320) — moderate heat"

                config CAM_FRAME_SIZE_VGA
                    bool "VGA (640x480) — HIGH HEAT, good quality"

                config CAM_FRAME_SIZE_SVGA
                    bool "SVGA (800x600) — VERY HIGH HEAT"

                config CAM_FRAME_SIZE_XGA
                    bool "XGA (1024x768) — EXTREME HEAT, not recommended"

            endchoice

            config CAM_JPEG_QUALITY
                int "JPEG quality (0-63)"
                default 15
                range 0 63
                depends on CAMERA_ENABLED
                help
                    JPEG compression quality. Lower values = better image quality
                    but larger file size and MORE HEAT from encoding.
                    Higher values = more compression, smaller files, less heat.
                    
                    Recommended values:
                      10-15: Good quality, moderate heat
                      20-30: Acceptable quality, reduced heat
                      40-50: Low quality, minimal heat
                    
                    For thermal management, 20-30 is recommended.

            config CAM_FRAME_RATE
                int "Target frame rate (fps)"
                default 10
                range 1 30
                depends on CAMERA_ENABLED
                help
                    Target frames per second for the MJPEG stream.
                    Lower frame rates significantly reduce heat and CPU usage.
                    
                    Recommended values:
                      5-10 fps: Low heat, suitable for navigation
                      15 fps: Moderate heat, smoother video
                      25-30 fps: HIGH HEAT, only for short bursts
                    
                    Actual frame rate may be lower if encoding cannot keep up.

            config CAM_FB_COUNT
                int "Frame buffer count"
                default 2
                range 1 3
                depends on CAMERA_ENABLED
                help
                    Number of frame buffers. More buffers reduce frame drops
                    but use more memory (each VGA buffer is ~150KB).
                    
                    1: Minimum memory, may drop frames
                    2: Recommended for streaming
                    3: Smoother but uses more PSRAM

        endmenu  # Camera Image Settings

        menu "Camera GPIO Pins"
            depends on CAMERA_ENABLED

            config CAM_PIN_PWDN
                int "Power down pin"
                default -1
                range -1 48
                help
                    GPIO for camera power down. -1 if not connected.

            config CAM_PIN_RESET
                int "Reset pin"
                default -1
                range -1 48
                help
                    GPIO for camera reset. -1 if not connected.

            config CAM_PIN_XCLK
                int "XCLK pin"
                default 40
                range 0 48

            config CAM_PIN_SIOD
                int "SCCB SDA pin"
                default 21
                range 0 48

            config CAM_PIN_SIOC
                int "SCCB SCL pin"
                default 47
                range 0 48

            config CAM_PIN_D7
                int "Data pin D7"
                default 48
                range 0 48

            config CAM_PIN_D6
                int "Data pin D6"
                default 46
                range 0 48

            config CAM_PIN_D5
                int "Data pin D5"
                default 45
                range 0 48

            config CAM_PIN_D4
                int "Data pin D4"
                default 42
                range 0 48

            config CAM_PIN_D3
                int "Data pin D3"
                default 41
                range 0 48

            config CAM_PIN_D2
                int "Data pin D2"
                default 2
                range 0 48

            config CAM_PIN_D1
                int "Data pin D1"
                default 1
                range 0 48

            config CAM_PIN_D0
                int "Data pin D0"
                default 0
                range 0 48

            config CAM_PIN_VSYNC
                int "VSYNC pin"
                default 3
                range 0 48

            config CAM_PIN_HREF
                int "HREF pin"
                default 8
                range 0 48

            config CAM_PIN_PCLK
                int "PCLK pin"
                default 22
                range 0 48

        endmenu  # Camera GPIO Pins

    endmenu  # Camera Configuration

endmenu  # Robot Controller Configuration
```
