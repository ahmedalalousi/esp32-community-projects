## esp32-robot-controller/main/archive/sdkconfig.defaults
```kconfig
# ============================================================================
# Robot Controller — sdkconfig.defaults
#
# Default configuration for Waveshare ESP32-S3-ETH board.
# These values are applied on first build (before menuconfig).
#
# Author: Ahmed Al-Alousi
# Date: February 2026
# ============================================================================

# ============================================================================
# Target / Flash / PSRAM (Waveshare ESP32-S3-ETH: 16MB flash, 8MB PSRAM)
# ============================================================================

CONFIG_ESPTOOLPY_FLASHSIZE_16MB=y
CONFIG_SPIRAM=y
CONFIG_SPIRAM_MODE_OCT=y
CONFIG_SPIRAM_SPEED_80M=y

# ============================================================================
# WiFi
# ============================================================================

CONFIG_WIFI_SSID="myssid"
CONFIG_WIFI_PASSWORD="mypassword"

# ============================================================================
# Ethernet (W5500 via SPI — Waveshare ESP32-S3-ETH pinout)
# ============================================================================

CONFIG_ENABLE_ETHERNET=y
CONFIG_ETH_SPI_HOST=2
CONFIG_ETH_SPI_SCLK_GPIO=13
CONFIG_ETH_SPI_MOSI_GPIO=11
CONFIG_ETH_SPI_MISO_GPIO=12
CONFIG_ETH_SPI_CS_GPIO=14
CONFIG_ETH_SPI_INT_GPIO=10
CONFIG_ETH_SPI_CLOCK_MHZ=20
CONFIG_ETH_PHY_RST_GPIO=9
CONFIG_ETH_PHY_ADDR=1

# ============================================================================
# Motor Driver
# ============================================================================

CONFIG_MOTOR_DRIVE_MODE_FOUR_WHEEL=y
CONFIG_MOTOR_WHEEL_BASE_MM=200
CONFIG_MOTOR_MAX_SPEED_MMS=500
CONFIG_MOTOR_MAX_DUTY_PCT=80
CONFIG_MOTOR_PWM_FREQ_HZ=5000
CONFIG_MOTOR_FL_PWM_GPIO=4
CONFIG_MOTOR_FL_DIR_GPIO=5
CONFIG_MOTOR_FR_PWM_GPIO=6
CONFIG_MOTOR_FR_DIR_GPIO=7
CONFIG_MOTOR_RL_PWM_GPIO=15
CONFIG_MOTOR_RL_DIR_GPIO=16
CONFIG_MOTOR_RR_PWM_GPIO=17
CONFIG_MOTOR_RR_DIR_GPIO=18

# ============================================================================
# PID Heading Correction
# ============================================================================

CONFIG_PID_ENABLED=y
CONFIG_PID_KP=150
CONFIG_PID_KI=20
CONFIG_PID_KD=5
CONFIG_PID_INTEGRAL_LIMIT=50
CONFIG_PID_OUTPUT_LIMIT=30

# ============================================================================
# I2C Bus (shared by IMU and URM09)
# ============================================================================

CONFIG_SENSOR_I2C_SDA=38
CONFIG_SENSOR_I2C_SCL=39
CONFIG_IMU_I2C_ADDR=0x68
CONFIG_URM09_I2C_ADDR=0x11

# ============================================================================
# Sensor Task
# ============================================================================

CONFIG_SENSOR_TASK_STACK_SIZE=4096
CONFIG_SENSOR_TASK_PRIORITY=6

# ============================================================================
# TCP Communication
# ============================================================================

CONFIG_TCP_CMD_PORT=8080
CONFIG_TCP_SENSOR_PORT=8081
CONFIG_TCP_SENSOR_HOST="192.168.1.100"
CONFIG_TCP_CAMERA_PORT=8082

# ============================================================================
# Camera (disabled by default — enable via menuconfig)
# ============================================================================

# CONFIG_CAMERA_ENABLED is not set

# ============================================================================
# Compiler
# ============================================================================

CONFIG_COMPILER_WARN_WRITE_STRINGS=y
```

## esp32-robot-controller/sdkconfig.defaults
```kconfig
# ============================================================================
# Robot Controller — sdkconfig.defaults
#
# Default configuration for Waveshare ESP32-S3-ETH board.
# These values are applied on first build (before menuconfig).
#
# IMPORTANT: Run 'idf.py fullclean' then 'idf.py build' to apply these!
#
# Author: Ahmed Al-Alousi
# Date: February 2026
# ============================================================================

# ============================================================================
# Target / Flash / PSRAM (Waveshare ESP32-S3-ETH: 16MB flash, 8MB PSRAM)
# ============================================================================

CONFIG_ESPTOOLPY_FLASHSIZE_16MB=y
CONFIG_SPIRAM=y
CONFIG_SPIRAM_MODE_OCT=y
CONFIG_SPIRAM_SPEED_80M=y

# ============================================================================
# WiFi
# ============================================================================

CONFIG_WIFI_SSID="Sumeria"
CONFIG_WIFI_PASSWORD="mypassword"

# ============================================================================
# Ethernet (W5500 via SPI — Waveshare ESP32-S3-ETH pinout)
# ============================================================================

CONFIG_ENABLE_ETHERNET=y
CONFIG_ETH_SPI_HOST=2
CONFIG_ETH_SPI_SCLK_GPIO=13
CONFIG_ETH_SPI_MOSI_GPIO=11
CONFIG_ETH_SPI_MISO_GPIO=12
CONFIG_ETH_SPI_CS_GPIO=14
CONFIG_ETH_SPI_INT_GPIO=10
CONFIG_ETH_SPI_CLOCK_MHZ=20
CONFIG_ETH_PHY_RST_GPIO=9
CONFIG_ETH_PHY_ADDR=1

# ============================================================================
# Motor Driver
# ============================================================================

CONFIG_MOTOR_DRIVE_MODE_FOUR_WHEEL=y
CONFIG_MOTOR_WHEEL_BASE_MM=200
CONFIG_MOTOR_MAX_SPEED_MMS=3000
CONFIG_MOTOR_MAX_DUTY_PCT=80
CONFIG_MOTOR_PWM_FREQ_HZ=20000
CONFIG_MOTOR_FL_PWM_GPIO=4
CONFIG_MOTOR_FL_DIR_GPIO=5
CONFIG_MOTOR_FR_PWM_GPIO=6
CONFIG_MOTOR_FR_DIR_GPIO=7
CONFIG_MOTOR_RL_PWM_GPIO=15
CONFIG_MOTOR_RL_DIR_GPIO=16
CONFIG_MOTOR_RR_PWM_GPIO=17
CONFIG_MOTOR_RR_DIR_GPIO=18

# ============================================================================
# PID Heading Correction
# ============================================================================

CONFIG_PID_ENABLED=y
CONFIG_PID_KP=150
CONFIG_PID_KI=20
CONFIG_PID_KD=5
CONFIG_PID_INTEGRAL_LIMIT=50
CONFIG_PID_OUTPUT_LIMIT=30

# ============================================================================
# IMU Configuration (MPU-9250)
# ============================================================================

CONFIG_IMU_I2C_ADDR=0x68
CONFIG_IMU_ACCEL_RANGE_2G=y
CONFIG_IMU_GYRO_RANGE_250=y

# ============================================================================
# I2C Bus (shared by camera SCCB, IMU, and URM09)
#
# Waveshare ESP32-S3-ETH uses GPIO 47/48 for the I2C bus.
# All devices share this bus per I2C specification.
# ============================================================================

CONFIG_SENSOR_I2C_SDA=48
CONFIG_SENSOR_I2C_SCL=47
CONFIG_URM09_I2C_ADDR=0x11

# ============================================================================
# Sensor Task
# ============================================================================

CONFIG_SENSOR_TASK_STACK_SIZE=4096
CONFIG_SENSOR_TASK_PRIORITY=6
CONFIG_SENSOR_POLL_INTERVAL_MS=100

# ============================================================================
# TCP Communication
#
# IMPORTANT: Set CONFIG_TCP_SENSOR_HOST to your Mac/Pi IP address!
# Run 'ipconfig getifaddr en0' on Mac to find your IP.
# ============================================================================

CONFIG_TCP_CMD_PORT=8080
CONFIG_TCP_SENSOR_PORT=8081
CONFIG_TCP_SENSOR_HOST="192.168.1.98"
CONFIG_TCP_CAMERA_PORT=8082

# ============================================================================
# Camera Configuration (Waveshare ESP32-S3-ETH pinout from schematic)
#
# Reference: https://files.waveshare.com/wiki/ESP32-S3-ETH/ESP32-S3-ETH-Schematic.pdf
# ============================================================================

CONFIG_CAMERA_ENABLED=y

# Camera power control (MOSFET gate)
CONFIG_CAM_PIN_PWDN=8
CONFIG_CAM_PIN_RESET=-1

# Camera clock
CONFIG_CAM_PIN_XCLK=3

# Camera SCCB (I2C-like interface) - FIXED for this board!
CONFIG_CAM_PIN_SIOD=48
CONFIG_CAM_PIN_SIOC=47

# Camera data bus (D0-D7)
CONFIG_CAM_PIN_D7=18
CONFIG_CAM_PIN_D6=15
CONFIG_CAM_PIN_D5=38
CONFIG_CAM_PIN_D4=40
CONFIG_CAM_PIN_D3=42
CONFIG_CAM_PIN_D2=46
CONFIG_CAM_PIN_D1=45
CONFIG_CAM_PIN_D0=41

# Camera sync signals
CONFIG_CAM_PIN_VSYNC=1
CONFIG_CAM_PIN_HREF=2
CONFIG_CAM_PIN_PCLK=39

# ============================================================================
# Compiler
# ============================================================================

CONFIG_COMPILER_WARN_WRITE_STRINGS=y
```

## sdkconfig.defaults
```kconfig
# ESP32-S3 Dual Interface Network Example - Default Configuration
# This file contains the essential settings for W5500 Ethernet + WiFi
#
# ============================================================================
# CRITICAL: ESP32-S3 Target and Flash/PSRAM Configuration
# ============================================================================
#
# This configuration is REQUIRED for ESP32-S3 with 16MB Flash + 8MB PSRAM
# Boards affected: Waveshare ESP32-S3-ETH, ESP32-S3-DevKitC-1, etc.
#
# WITHOUT these settings, the project may:
# - Fail to build with flash/PSRAM errors
# - Build but fail to boot (brownout, heap errors)
# - Run but crash under load
#
# If your board has DIFFERENT specs, adjust the flash/PSRAM settings below!
# ============================================================================

# ============================================================================
# ESP32-S3 Chip Configuration (CRITICAL for Waveshare ESP32-S3-ETH)
# ============================================================================

# Set target to ESP32-S3 (REQUIRED)
CONFIG_IDF_TARGET="esp32s3"
CONFIG_IDF_TARGET_ESP32S3=y

# Flash Configuration (16MB) - CRITICAL
# Most ESP32-S3 boards have 16MB flash (Waveshare ESP32-S3-ETH standard)
CONFIG_ESPTOOLPY_FLASHSIZE_16MB=y
CONFIG_ESPTOOLPY_FLASHSIZE="16MB"
CONFIG_ESPTOOLPY_FLASHMODE_QIO=y
CONFIG_ESPTOOLPY_FLASHFREQ_80M=y

# Partition Table - Use large single app partition for 16MB flash
CONFIG_PARTITION_TABLE_SINGLE_APP_LARGE=y

# PSRAM Configuration (8MB Octal PSRAM) - CRITICAL for stability
# Waveshare ESP32-S3-ETH has 8MB Octal PSRAM
CONFIG_SPIRAM=y
CONFIG_SPIRAM_MODE_OCT=y
CONFIG_SPIRAM_SPEED_80M=y

# PSRAM Memory Allocation Strategy
CONFIG_SPIRAM_USE_MALLOC=y
CONFIG_SPIRAM_MALLOC_ALWAYSINTERNAL=16384
CONFIG_SPIRAM_MALLOC_RESERVE_INTERNAL=32768

# Allow large allocations in PSRAM
CONFIG_SPIRAM_TRY_ALLOCATE_WIFI_LWIP=y

# USB Configuration (ESP32-S3 has native USB)
# Use USB Serial/JTAG for console output (not UART0)
CONFIG_ESP_CONSOLE_USB_SERIAL_JTAG=y
CONFIG_ESP_CONSOLE_SECONDARY_NONE=y

# ============================================================================
# Ethernet Configuration (W5500 via SPI)
# ============================================================================

# Ethernet is controlled via menuconfig: Ethernet Configuration menu
# When enabled, these settings apply:
# CONFIG_ETH_ENABLED=y
# CONFIG_ETH_USE_SPI_ETHERNET=y
# CONFIG_ETH_SPI_ETHERNET_W5500=y

# Enable Ethernet by default (can be disabled in menuconfig)
CONFIG_ENABLE_ETHERNET=y

# ============================================================================
# WiFi Configuration
# ============================================================================

# WiFi is enabled by default in ESP-IDF
# SSID and password are set via menuconfig or Kconfig.projbuild

# ============================================================================
# Network Stack Configuration
# ============================================================================

# Enable both WiFi and Ethernet routing
CONFIG_LWIP_IP_FORWARD=y
CONFIG_LWIP_IPV4=y

# Increase LWIP task priority for better performance
CONFIG_LWIP_TCPIP_TASK_PRIO=19

# ============================================================================
# Logging Configuration (Optional - for debugging)
# ============================================================================

# Set default log level to INFO
CONFIG_LOG_DEFAULT_LEVEL_INFO=y

# Enable specific component logging for debugging (optional)
# CONFIG_LOG_DEFAULT_LEVEL_DEBUG=y
# CONFIG_ETH_LOG_LEVEL_DEBUG=y
# CONFIG_WIFI_LOG_LEVEL_DEBUG=y

# ============================================================================
# FreeRTOS Configuration
# ============================================================================

# Increase main task stack size
CONFIG_ESP_MAIN_TASK_STACK_SIZE=8192

# ============================================================================
# Compiler Options
# ============================================================================

# Enable compiler warnings
CONFIG_COMPILER_WARN_WRITE_STRINGS=y
```
